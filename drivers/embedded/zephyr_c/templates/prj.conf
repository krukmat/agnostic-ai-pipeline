## CMakeLists.txt
```
cmake_minimum_required(VERSION 3.20.0)
find_package(Zephyr REQUIRED HINTS $ENV{ZEPHYR_BASE})
project(zephyr_app)

target_sources(app PRIVATE src/main.c)
```

## prj.conf
```kconfig
# Minimal Zephyr configuration
CONFIG_STDOUT_CONSOLE=y
CONFIG_PRINTK=y
```

## src/main.c
```c
#include <zephyr/kernel.h>
#include <zephyr/sys/printk.h>

int main(void)
{
    while (1) {
        printk("Zephyr scaffold running...\n");
        k_sleep(K_MSEC(1000));
    }
    return 0;
}
```
